## kernel-4-14-78/arch/arm64/boot/kernel.its
```
/*
 * Copyright (C) 2015, Freescale Semiconductor
 *
 * Mingkai Hu <Mingkai.hu@freescale.com>
 * Hou Zhiqiang <B48286@freescale.com>
 * Bhupesh Sharma <bhupesh.sharma@freescale.com>
 * Harninder Rai <harninder.rai@freescale.com>
 *
 * This file is licensed under the terms of the GNU General Public
 * License version 2.  This program is licensed "as is" without any
 * warranty of any kind, whether express or implied.
 */

/dts-v1/;

/ {
	description = "Image file for the Linux Kernel";
	#address-cells = <1>;

	images {
		kernel@1 {
			description = "ARM64 Linux kernel";
			data = ("Image");
			type = "kernel";
			arch = "arm64";
			os = "linux";
			compression = "none";
			load = <0x80080000>;
			entry = <0x80080000>;
		};
		fdt@1 {
			description = "Flattened Device Tree blob";
			data = ("seco-imx8mq-c12.dtb");
			type = "flat_dt";
			arch = "arm64";
			compression = "none";
			load = <0x90000000>;
		};
		ramdisk@1 {
			description = "Ramdisk";
			data = /incbin/("initrd.gz");
			type = "ramdisk";
			arch = "arm64";
			os = "linux";
			compression = "gz";
		};
	};

	configurations {
		default = "config@1";
		config@1 {
			description = "Boot Linux kernel";
			kernel = "kernel@1";
			fdt = "fdt@1";
			ramdisk = "ramdisk@1";
		};
	};
};
```

## kernel-4-14-78/drivers/seco/Kconfig
```kconfig
#
#  SECO system driver
#

config ECTRL
	bool "Communication system with the Embedded Controller"
	depends on I2C && ARCH_MXC_ARM64
	help
		Say Y here if you want to use the Seco Communication System with the Embedded Controller.

		if usure, say Y.
```

## u-boot-imx_v2018-03-r0-imx8/board/seco/seco_imx8qm_c26/Kconfig
```kconfig
if TARGET_SECO_IMX8QM_C26

config SYS_BOARD
	default "seco_imx8qm_c26"

config SYS_VENDOR
	default "seco"

config SYS_CONFIG_NAME
	default "seco_imx8qm_c26"

source "board/seco/common/Kconfig"

endif
```
