/*
 * Copyright 2017-2018 NXP
 *
 * This program is free software; you can redistribute it and/or
 * modify it under the terms of the GNU General Public License
 * as published by the Free Software Foundation; either version 2
 * of the License, or (at your option) any later version.
 *
 * This program is distributed in the hope that it will be useful,
 * but WITHOUT ANY WARRANTY; without even the implied warranty of
 * MERCHANTABILITY or FITNESS FOR A PARTICULAR PURPOSE.  See the
 * GNU General Public License for more details.
 */
/*
 * LVDS1  - enable ldb1 display.
 */

/dts-v1/;
/plugin/;

#include <dt-bindings/clock/imx8qm-clock.h>

/ {
        compatible = "fsl,imx8qm-mek","fsl,seco-imx8qm-c26", "fsl,imx8qm";

/*  __________________________________________________________________________
 * |                                                                          |
 * |                               LVDS1 OVERLAY                              |
 * |__________________________________________________________________________|
 */


	fragment@0 {
                target = <&ldb2_phy>;
                __overlay__ {
			status = "okay";
        	};
        };

	fragment@1 {
                target = <&ldb2>;
                __overlay__ {
                        status = "okay";
                };
        };

	fragment@2 {
                target = <&i2c0_lvds1>;
                __overlay__ {
			status = "okay";
                };
        };

};
