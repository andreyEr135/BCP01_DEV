/*
 * Copyright 2017 NXP
 *
 * This program is free software; you can redistribute it and/or
 * modify it under the terms of the GNU General Public License
 * as published by the Free Software Foundation; either version 2
 * of the License, or (at your option) any later version.
 *
 * This program is distributed in the hope that it will be useful,
 * but WITHOUT ANY WARRANTY; without even the implied warranty of
 * MERCHANTABILITY or FITNESS FOR A PARTICULAR PURPOSE.  See the
 * GNU General Public License for more details.
 */

/dts-v1/;
/plugin/;

/ {
	compatible = "fsl,imx8mq-evk","fsl,seco-imx8mq-c25", "fsl,imx8mq"; 

/*  __________________________________________________________________________
 * |                                                                          |
 * |                               CAN RTC	                              |
 * |__________________________________________________________________________|
 */


    	fragment@0 {
        	target = <&reg_hdmi_lvl_en>;
        	__overlay__ {
			regulator-boot-on;
                        regulator-always-on;	
		};
	};

    	fragment@1 {
        	target = <&hdmi>;
        	__overlay__ {
			compatible = "fsl,imx8mq-dp";
			dp-lane-mapping = <0xc6>;
			dp-link-rate = <0x14>;
			dp-num-lanes = <0x4>;
		};
	};
};

